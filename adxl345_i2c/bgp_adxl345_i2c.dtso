/*
 * bgp_adxl345_i2c.dtso
 * Simple DT Overlay for the ADXL345 on the TI BeaglePlay
 * I2C-1 bus, slave addr 0x53
 */
/dts-v1/;
/plugin/;

&main_i2c1 {
	status = "okay";

	#address-cells = <1>;
	#size-cells = <0>;

	adxl345@53 {
		compatible = "custom,adxl345";
		reg = <0x53>;
		status = "okay";
	};
};
